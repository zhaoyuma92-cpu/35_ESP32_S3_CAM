## experiments/wifi_only/sdkconfig.defaults
```kconfig
# ── Target ────────────────────────────────────────────────────────────────────
CONFIG_IDF_TARGET="esp32p4"

# ── ESP32-P4 silicon (Waveshare NANO board uses rev v1.3 pre-production) ──────
CONFIG_ESP32P4_SELECTS_REV_LESS_V3=y
CONFIG_ESP32P4_REV_MIN_100=y
CONFIG_IDF_EXPERIMENTAL_FEATURES=y

# ── Flash (16 MB, 40 MHz — safe for rev v1.3) ─────────────────────────────────
CONFIG_ESPTOOLPY_FLASHSIZE_16MB=y
CONFIG_ESPTOOLPY_FLASHFREQ_40M=y

# ── PSRAM (HEX mode, 80 MHz conservative for v1.x silicon) ───────────────────
CONFIG_SPIRAM=y
CONFIG_SPIRAM_MODE_HEX=y
CONFIG_SPIRAM_SPEED_80M=y

# ── FreeRTOS ──────────────────────────────────────────────────────────────────
CONFIG_FREERTOS_HZ=1000

# ── Log (keep verbose available for debug) ───────────────────────────────────
CONFIG_LOG_MAXIMUM_LEVEL_VERBOSE=y

# ── WiFi — STA only, disable SoftAP to save RAM ──────────────────────────────
CONFIG_ESP_WIFI_SOFTAP_SUPPORT=n

# ── esp_hosted slave: onboard ESP32-C6 ───────────────────────────────────────
CONFIG_SLAVE_IDF_TARGET_ESP32C6=y

# ── esp_hosted transport: SDIO ───────────────────────────────────────────────
CONFIG_ESP_HOSTED_SDIO_HOST_INTERFACE=y
CONFIG_ESP_HOSTED_SDIO_4_BIT_BUS=y

# Clock: start at 20 MHz for bring-up; increase to 40 MHz once SDIO is stable
CONFIG_ESP_HOSTED_SDIO_CLOCK_FREQ_KHZ=20000

# ── SDIO GPIO mapping (Waveshare ESP32-P4-NANO schematic) ────────────────────
# Slot 0 GPIO matrix — dedicated lines to onboard C6
CONFIG_ESP_HOSTED_SDIO_GPIO_RESET_SLAVE=54
CONFIG_ESP_HOSTED_SDIO_PIN_CLK=18
CONFIG_ESP_HOSTED_SDIO_PIN_CMD=19
CONFIG_ESP_HOSTED_SDIO_PIN_D0=14
CONFIG_ESP_HOSTED_SDIO_PIN_D1=15
CONFIG_ESP_HOSTED_SDIO_PIN_D2=16
CONFIG_ESP_HOSTED_SDIO_PIN_D3=17
```

## main/Kconfig.projbuild
```kconfig
menu "Four-target displacement acquisition"

config DISP_FAKE_CAMERA
    bool "Use fake camera backend"
    default y
    help
        Generate synthetic grayscale frames for pipeline testing. Disable this
        when the ESP32-P4 MIPI-CSI OV5647 backend is implemented.

config DISP_FAKE_FRAME_WIDTH
    int "Fake camera frame width"
    default 1280
    depends on DISP_FAKE_CAMERA
    help
        Width of the synthetic frame. Requires PSRAM for full 1280x960
        (1228800 bytes). Set to 320 for internal-RAM-only testing.

config DISP_FAKE_FRAME_HEIGHT
    int "Fake camera frame height"
    default 960
    depends on DISP_FAKE_CAMERA
    help
        Height of the synthetic frame.

config DISP_AUTOSTART
    bool "Start acquisition automatically at boot"
    default y
    help
        Useful for early bring-up before HTTP/master control is added.

config DISP_OUTPUT_PATH
    string "CSV output path"
    default "/sdcard/displacement.csv"
    help
        Path used by the CSV writer. If the filesystem is not mounted yet, the
        writer logs a warning and the pipeline still runs.

endmenu

menu "WiFi (optional)"

config DISP_ENABLE_WIFI
    bool "Enable WiFi via onboard ESP32-C6 (SDIO)"
    default n
    help
        Enables esp_hosted + esp_wifi_remote to connect the ESP32-C6 coprocessor
        to WiFi. When disabled, no SDIO init is performed and the 30fps pipeline
        is unaffected.

config DISP_WIFI_SSID
    string "WiFi SSID (2.4 GHz)"
    default "Xiaomi_BDA5"
    depends on DISP_ENABLE_WIFI

config DISP_WIFI_PASSWORD
    string "WiFi password"
    default "mzy19920720"
    depends on DISP_ENABLE_WIFI

config DISP_WIFI_MAX_RETRY
    int "Max WiFi reconnect attempts"
    default 5
    depends on DISP_ENABLE_WIFI

endmenu
```

## sdkconfig.defaults
```kconfig
CONFIG_IDF_TARGET="esp32p4"
# Real OV5647 MIPI-CSI camera backend (disable fake camera)
CONFIG_DISP_FAKE_CAMERA=n

# Disable SPI camera controller — project uses MIPI CSI (OV5647), not SPI.
# CAM_CTRL_SPI_ENABLE=y + SPIRAM=y triggers spi_slave.c which uses IDF v5.4+ HAL APIs.
CONFIG_CAM_CTRL_SPI_ENABLE=n

# OV5647 sensor driver — must be explicitly enabled (default n in component)
CONFIG_CAMERA_OV5647=y
CONFIG_CAMERA_OV5647_AUTO_DETECT_MIPI_INTERFACE_SENSOR=y
CONFIG_CAMERA_OV5647_MIPI_RAW8_800X640_50FPS=y
CONFIG_CAMERA_OV5647_MIPI_RAW10_1280X960_BINNING_45FPS=y
CONFIG_CAMERA_OV5647_MIPI_DEFAULT_FMT_RAW8_800X640_50FPS=y
CONFIG_IDF_EXPERIMENTAL_FEATURES=y

# Keep the readable CSV name /sdcard/displacement.csv working on FATFS.
CONFIG_FATFS_LFN_HEAP=y
CONFIG_FREERTOS_HZ=1000
CONFIG_COMPILER_OPTIMIZATION_PERF=y

# Flash: actual chip is 16MB; keep 40MHz for chip rev v1.3 compatibility
CONFIG_ESPTOOLPY_FLASHSIZE_16MB=y
CONFIG_ESPTOOLPY_FLASHFREQ_40M=y

# Chip revision: this board has ESP32-P4 rev v1.3 (pre-production silicon).
# Rev <3.0 and >=3.0 are mutually exclusive in IDF v5.5 -- must select the <v3 path.
CONFIG_ESP32P4_SELECTS_REV_LESS_V3=y
CONFIG_ESP32P4_REV_MIN_100=y

# PSRAM: HEX mode at 80MHz (conservative speed for v1.x silicon)
CONFIG_SPIRAM=y
CONFIG_SPIRAM_MODE_HEX=y
CONFIG_SPIRAM_SPEED_80M=y

# Enable verbose log level at compile time so esp_log_level_set(VERBOSE) works
CONFIG_LOG_MAXIMUM_LEVEL_VERBOSE=y

# WiFi: enabled by default for HTTP API and UDP discovery
CONFIG_DISP_ENABLE_WIFI=y
CONFIG_DISP_AUTOSTART=n
CONFIG_ESP_WIFI_SOFTAP_SUPPORT=n

# esp_hosted slave: onboard ESP32-C6 via SDIO
CONFIG_SLAVE_IDF_TARGET_ESP32C6=y
CONFIG_ESP_HOSTED_SDIO_HOST_INTERFACE=y
CONFIG_ESP_HOSTED_SDIO_4_BIT_BUS=y
CONFIG_ESP_HOSTED_SDIO_CLOCK_FREQ_KHZ=20000

# SDIO GPIO mapping (Waveshare ESP32-P4-NANO, SLOT_1 GPIO matrix)
CONFIG_ESP_HOSTED_SDIO_GPIO_RESET_SLAVE=54
CONFIG_ESP_HOSTED_SDIO_PIN_CLK=18
CONFIG_ESP_HOSTED_SDIO_PIN_CMD=19
CONFIG_ESP_HOSTED_SDIO_PIN_D0=14
CONFIG_ESP_HOSTED_SDIO_PIN_D1=15
CONFIG_ESP_HOSTED_SDIO_PIN_D2=16
CONFIG_ESP_HOSTED_SDIO_PIN_D3=17
```
